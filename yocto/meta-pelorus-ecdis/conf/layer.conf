## yocto/meta-pelorus-ecdis/conf/layer.conf
```bitbake
# Pelorus ECDIS — companion Yocto layer (Weston / IVI integration stubs).

BBPATH .= ":${LAYERDIR}"

BBFILES += "${LAYERDIR}/recipes-*/*/*.bb"

BBFILE_COLLECTIONS += "pelorus-ecdis"
BBFILE_PATTERN_pelorus-ecdis = "^${LAYERDIR}/"
BBFILE_PRIORITY_pelorus-ecdis = "8"

LAYERSERIES_COMPAT_pelorus-ecdis = "scarthgap nanbield walnascar"

# Building `ecdis-ui` needs `cargo` bbclass from meta-rust (or another Rust integration layer).
```
